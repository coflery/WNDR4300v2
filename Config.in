## Config.in
```kconfig
# Copyright (C) 2006-2009 OpenWrt.org
#
# This is free software, licensed under the GNU General Public License v2.
# See /LICENSE for more information.
#

mainmenu "OpenWrt Configuration"

config HAVE_DOT_CONFIG
	bool
	default y

menu "Flash Type"
	choice
		prompt "Flash Type Selection"
		config NAND_FLASH
			bool "NAND flash"
		
		config NOR_FLASH
			bool "NOR flash"
	endchoice
endmenu

source "target/Config.in"

menu "Target Images"
	config TARGET_ROOTFS_INITRAMFS
		bool "ramdisk"
		default y if USES_INITRAMFS
		depends LINUX_2_6
		help
		  Embed the rootfs into the kernel (initramfs)

	choice
		prompt "ramdisk compression"
		depends TARGET_ROOTFS_INITRAMFS
		depends !LINUX_2_6_21
		depends !LINUX_2_6_25
		depends !LINUX_2_6_27
		depends !LINUX_2_6_28
		default TARGET_INITRAMFS_COMPRESSION_LZMA if TARGET_ar71xx
		default TARGET_INITRAMFS_COMPRESSION_NONE
		help
		  Select ramdisk compression.

		config TARGET_INITRAMFS_COMPRESSION_NONE
			bool "NONE"

		config TARGET_INITRAMFS_COMPRESSION_GZIP
			bool "GZIP"

		config TARGET_INITRAMFS_COMPRESSION_BZIP2
			bool "BZIP2"

		config TARGET_INITRAMFS_COMPRESSION_LZMA
			bool "LZMA"
	endchoice

	config TARGET_ROOTFS_JFFS2
		bool "jffs2"
		default y if USES_JFFS2
		depends !TARGET_ROOTFS_INITRAMFS
		help
		  Build a jffs2 root filesystem

	config TARGET_ROOTFS_SQUASHFS
		bool "squashfs"
		default y if USES_SQUASHFS
		depends !TARGET_ROOTFS_INITRAMFS
		help
		  Build a squashfs-lzma root filesystem

	config TARGET_ROOTFS_TGZ
		bool "tgz"
		default y if USES_TGZ
		depends !TARGET_ROOTFS_INITRAMFS
		help
		  Build a compressed tar archive of the the root filesystem

	config TARGET_ROOTFS_CPIOGZ
		bool "cpiogz"
		default y if USES_CPIOGZ
		depends !TARGET_ROOTFS_INITRAMFS
		help
		  Build a compressed cpio archive of the the root filesystem

	config TARGET_ROOTFS_EXT2FS
		bool "ext2"
		default y if USES_EXT2
		depends !TARGET_ROOTFS_INITRAMFS
		help
		  Ext2 file system with some free space for uml images

	config TARGET_ROOTFS_ISO
		bool "iso"
		default n
		depends TARGET_ROOTFS_INITRAMFS && TARGET_x86
		help
		  Create some bootable ISO image

comment "Image Options"

source "target/linux/*/image/Config.in"

    config TARGET_ROOTFS_FSPART
        int "Filesystem part size (in MB)"
        depends X86_GRUB_IMAGES || TARGET_ROOTFS_EXT2FS || TARGET_rb532 || TARGET_olpc
        default 48
        help
            Allows you to change the filesystem partition size

    config TARGET_ROOTFS_MAXINODE
        int "Maximum number of inodes in filesystem"
        depends TARGET_ROOTFS_EXT2FS
        default 6000
        help
            Allows you to change the maximum number of inodes in the filesystem

endmenu

menu "Global build settings"

config ALL
	bool "Select all packages by default"
	default n

comment "General build options"

config CLEAN_IPKG
	bool
	prompt "Disable ipkg/opkg installation on the target"
	default n
	help
		This removes all ipkg data from the target directory before building the root fs

config CLEAN_TOOLCHAIN_CACHE
	bool
	prompt "Enable Delete all temporary toolchain files in build_dir"
	default y
	help
		 This removes all tmporary toolchain data from the build_dir	

config LARGEFILE
	bool
	prompt "Enable large file (files > 2 GB) support"
	default y
	help
	  Enable large file (files > 2 GB) support.

config SHADOW_PASSWORDS
	bool
	prompt "Enable shadow password support"
	default y
	help
	  Enable shadow password support.

choice
	prompt "Binary stripping method"
	default USE_STRIP   if EXTERNAL_TOOLCHAIN
	default USE_STRIP   if USE_GLIBC || USE_EGLIBC
	default USE_SSTRIP
	help
	  Select the binary stripping method you wish to use.

	config NO_STRIP
		bool "none"
		help
		  This will install unstripped binaries (useful for native compiling/debugging)

	config USE_STRIP
		bool "strip"
		help
		  This will install binaries stripped using strip from binutils


	config USE_SSTRIP
		bool "sstrip"
		depends !USE_GLIBC
		depends !USE_EGLIBC
		help
		  This will install binaries stripped using sstrip

endchoice

config USE_MKLIBS
	bool "Strip unnecessary functions from libraries"
	help
	  Reduces libraries to only those functions that are necessary for using all
	  selected packages (including those selected as <M>)
	  Note that this will make the system libraries incompatible with most of the packages
	  that are not selected during the build process

config STRIP_KERNEL_EXPORTS
	depends LINUX_2_6
	bool "Strip unnecessary exports from the kernel image"
	help
	  Reduces kernel size by stripping unused kernel exports from the kernel image
	  Note that this might make the kernel incompatible with any kernel modules that
	  were not selected at the time the kernel image was created

comment "Package build options"

config DEBUG
	bool
	prompt "Compile packages with debugging info"
	default n
	help
		Disables stripping and adds -g3 to the CFLAGS

config DEBUG_DIR
	bool "Install debugging binaries into a staging directory"
	default n
	help
		This will install all compiled package binaries into build_dir/target-*/debug-*/,
		useful for cross-debugging via gdb/gdbserver

config IPV6
        bool
        prompt "Enable IPv6 support in packages"
        default n
        help
                Enable IPV6 support in packages (passes --enable-ipv6 to configure scripts).

comment "Kernel build options"

config KERNEL_KALLSYMS
	bool "Compile the kernel with symbol table information"
	default n
	help
		This will give you more information in stack traces from kernel oopses

config KERNEL_PROFILING
	bool "Compile the kernel with profiling enabled"
	default n
	help
		Enable the extended profiling support mechanisms used by profilers such
		as OProfile.

config KERNEL_DEBUG_FS
	bool "Compile the kernel with Debug Filesystem enabled"
	depends LINUX_2_6
	default y
	help
		debugfs is a virtual file system that kernel developers use to put
		debugging files into. Enable this option to be able to read and
		write to these files.

endmenu

menuconfig DEVEL
	bool "Advanced configuration options (for developers)"
	default n

config BROKEN
	bool
	prompt "Show broken platforms / packages" if DEVEL
	default n

config DOWNLOAD_FOLDER
	string
	prompt "Download folder" if DEVEL
	default ""

config LOCALMIRROR
	string
	prompt "Local mirror for source packages" if DEVEL

config AUTOREBUILD
	bool
	prompt "Automatic rebuild of packages" if DEVEL
	default y
	help
		Automatically rebuild packages when their files change

config BUILD_SUFFIX
	string
	prompt "Build suffix to append to the BUILD_DIR variable" if DEVEL
	default ""
	help
		Build suffix to append to the BUILD_DIR variable, i.e: build_dir_suffix

config TARGET_ROOTFS_DIR
	string
	prompt "Override the default TARGET_ROOTFS_DIR variable" if DEVEL
	default ""
	help
		Override the default TARGET_ROOTFS_DIR variable content $(BUILD_DIR) with custom path.
		Use this option to re-define the location of the target root file system directory.

config CCACHE
	bool
	prompt "Use ccache" if DEVEL
	default n
	help
		Compiler cache; see http://ccache.samba.org/

config EXTERNAL_KERNEL_TREE
	string
	prompt "Use external kernel tree" if DEVEL
	default ""

config KERNEL_GIT_CLONE_URI
	string
	prompt "Enter git repository to clone" if DEVEL
	default ""
	help
		Enter the full git repository path i.e.:
		git://git.kernel.org/pub/scm/linux/kernel/git/torvalds/linux-2.6.git
		This will create a git clone of the kernel in your build
		directory.

config KERNEL_GIT_LOCAL_REPOSITORY
	string
	prompt "Enter path to local reference repository" if DEVEL
	default ""
	help
		Enter a full pathname to a local reference git repository.
		In this instance, the --refererence option of git clone will
		be used thus creating a quick local clone of your repo.


menuconfig TARGET_OPTIONS
	bool "Target Options"  if DEVEL

config TARGET_OPTIMIZATION
	string
	prompt "Target Optimizations" if TARGET_OPTIONS
	default DEFAULT_TARGET_OPTIMIZATION
	help
	  Optimizations to use when building for the target host.

config SOFT_FLOAT
	bool
	prompt "Use software floating point by default" if TARGET_OPTIONS
	default y
	depends on (arm || armeb || powerpc || mipsel || mips) && !HAS_FPU
	help
	  If your target CPU does not have a Floating Point Unit (FPU) or a
	  kernel FPU emulator, but you still wish to support floating point
	  functions, then everything will need to be compiled with soft floating
	  point support (-msoft-float).

	  Most people will answer N.


source "toolchain/Config.in"

source "target/imagebuilder/Config.in"
source "target/sdk/Config.in"

source "tmp/.config-package.in"

menu "DNI common configuration"
menu "Interface names"
	config WAN_PHYNAME_ENABLE
		bool "Select to configure WAN Physical Interface"
		default y
		help
			"If you want to configure WAN Physical Interface, you should select it."
	
	menu "WAN Physical Interface Configuration"
	depends on WAN_PHYNAME_ENABLE
		config WAN_PHYNAME
			string
			prompt "WAN Physical Interface"
			default "eth1"
			help
				"WAN Physical Interface"
	endmenu

	config LAN_PHYNAME_ENABLE
		bool "Select to configure LAN Physical Interface"
		default y
		help
			"If you want to configure LAN Physical Interface, you should select it."

	menu "LAN Physical Interface Configuration"
	depends on LAN_PHYNAME_ENABLE
		config LAN_PHYNAME
			string
			prompt "LAN Physical Interface"
			default "eth0"
			help
				"LAN Physical Interface"
	endmenu
	
	config WLAN_NG_PHYNAME_ENABLE
		bool "Select to configure WLAN NG Physical Interface"
		default y
		help
			"If you want to configure WLAN NG Physical Interface, you should select it."

	menu "WLAN NG Physical Interface Configuration"
	depends on WLAN_NG_PHYNAME_ENABLE
		config WLAN_NG_PHYNAME
			string
			prompt "WLAN NG Physical Interface"
			default "wifi0"
			help
				"WLAN NG Physical Interface"
	endmenu

	config WLAN_A_PHYNAME_ENABLE
		bool "Select to configure WLAN A Physical Interface"
		default y
		help
			"If you want to configure WLAN A Physical Interface, you should select it."

	menu "WLAN A Physical Interface Configuration"
	depends on WLAN_A_PHYNAME_ENABLE
		config WLAN_A_PHYNAME
			string
			prompt "WLAN A band Physical Interface"
			default "wifi1"
			help
				"WLAN A band Physical Interface"
	endmenu

	config WAN_IFNAME_ENABLE
		bool "Select to configure WAN Interface"
		default y
		help
			"If you want to configure WAN Interface, you should select it."

	menu "WAN Interface Configuration"
	depends on WAN_IFNAME_ENABLE
		config WAN_IFNAME
			string
			prompt "WAN interface name"
			default "eth1"
			help
				"WAN interface name"
	endmenu

	config LAN_IFNAME_ENABLE
		bool "Select to configure LAN Interface"
		default y
		help
			"If you want to configure LAN Interface, you should select it."

	menu "LAN Interface Configuration"
	depends on LAN_IFNAME_ENABLE
		config LAN_IFNAME
			string
			prompt "LAN interface name"
			default "eth0"
			help
				"LAN interface name"
	endmenu

	config WLAN_NG_IFNAME_ENABLE
		bool "Select to configure WLAN NG Interface"
		default y
		help
			"If you want to configure WLAN NG Interface, you should select it."

	menu "WLAN NG Interface Configuration"
	depends on WLAN_NG_IFNAME_ENABLE
		config WLAN_NG_IFNAME
			string
			prompt "WLAN 11ng interface name"
			default "ath0"
			help
				"WLAN 11ng interface name"
	endmenu
	
	config WLAN_A_IFNAME_ENABLE
		bool "Select to configure WLAN A Interface"
		default y
		help
			"If you want to configure WLAN A Interface, you should select it."

	menu "WLAN A Interface Configuration"
	depends on WLAN_A_IFNAME_ENABLE
		config WLAN_A_IFNAME
			string
			prompt "WLAN 11na/ac interface name"
			default "ath1"
			help
				"WLAN 11na/ac interface name"
	endmenu

	config WLAN_IFNAME_2_ENABLE
		bool "Select to configure 2nd WLAN 11na/ac/ng Interface"
		default y
		help
			"If you want to configure 2nd WLAN 11na/ac/ng Interface, you should select it."

	menu "The 2nd WLAN Interface Configuration"
	depends on WLAN_IFNAME_2_ENABLE
		config WLAN_IFNAME_2
			string
			prompt "The 2nd WLAN 11na/ac/ng interface name"
			default "ath2"
			help
				"The 2nd WLAN 11na/ac/ng interface name"
	endmenu

	config WLAN_IFNAME_3_ENABLE
		bool "Select to configure 3rd WLAN 11na/ac/ng Interface"
		default y
		help
			"If you want to configure 3rd WLAN 11na/ac/ng Interface, you should select it."

	menu "The 3nd WLAN Interface Configuration"
	depends on WLAN_IFNAME_3_ENABLE
		config WLAN_IFNAME_3
			string
			prompt "The 3rd WLAN 11na/ac/ng interface name"
			default "ath3"
			help
				"The 3rd WLAN 11na/ac/ng interface name"
	endmenu
	
	config BRIDGE_IFNAME_ENABLE
		bool "Select to configure Bridge Interface"
		default y
		help
			"If you want to configure Bridge Interface, you should select it."

	menu "The Bridge Interface Configuration"
	depends on BRIDGE_IFNAME_ENABLE
		config BRIDGE_IFNAME
			string
			prompt "Bridge interface name"
			default "br0"
			help
				"Bridge interface name"
	endmenu

	config IPTV_BRIDGE_IFNAME_ENABLE
		bool "Select to configure IPTV Bridge Interface"
		default y
		help
			"If you want to configure IPTV Bridge Interface, you should select it."

	menu "The IPTV Bridge Interface Configuration"
	depends on IPTV_BRIDGE_IFNAME_ENABLE
		config IPTV_BRIDGE_IFNAME
			string
			prompt "IPTV Bridge interface name"
			default "br1"
			help
				"IPTV Bridge interface name"
	endmenu

	config PPP_IFNAME_ENABLE
		bool "Select to configure PPP Interface"
		default y
		help
			"If you want to configure PPP Interface, you should select it."

	menu "The PPP Interface Configuration"
	depends on PPP_IFNAME_ENABLE
		config PPP_IFNAME
			string
			prompt "PPP interface name"
			default "ppp0"
			help
				"PPP interface name"
	endmenu

	config MULTI_PPP_IFNAME_ENABLE
		bool "Select to configure MULTI PPP Interface"
		default y
		help
			"If you want to configure MULTI PPP Interface, you should select it."

	menu "The MULTI PPP Interface Configuration"
	depends on MULTI_PPP_IFNAME_ENABLE
		config MULTI_PPP_IFNAME
			string
			prompt "Multi PPP interface name"
			default "ppp1"
			help
				"Multi PPP interface name"
	endmenu

	config IPV6_PPPOE_IFNAME_ENABLE
		bool "Select to configure IPv6 PPPoE Interface"
		default y
		help
			"If you want to configure IPv6 PPPoE Interface, you should select it."

	menu "The IPv6 PPPoE Interface Configuration"
	depends on IPV6_PPPOE_IFNAME_ENABLE
		config IPV6_PPPOE_IFNAME
			string
			prompt "IPv6 PPPoE interface name"
			default "ppp2"
			help
				"IPv6 PPPoE interface name"
	endmenu

	config IPV6_L2TP_IFNAME_ENABLE
		bool "Select to configure IPv6 L2TP Interface"
		default y
		help
			"If you want to configure IPv6 L2TP Interface, you should select it."

	menu "The IPv6 L2TP Interface Configuration"
	depends on IPV6_L2TP_IFNAME_ENABLE
		config IPV6_L2TP_IFNAME
			string
			prompt "IPv6 L2TP interface name"
			default "ppp3"
			help
				"IPv6 L2TP interface name"
	endmenu
	
	config IPV6_6TO4_IFNAME_ENABLE
		bool "Select to configure IPv6 6to4 Interface"
		default y
		help
			"If you want to configure IPv6 6to4 Interface, you should select it."

	menu "The IPv6 6to4 Interface Configuration"
	depends on IPV6_6TO4_IFNAME_ENABLE
		config IPV6_6TO4_IFNAME
			string
			prompt "IPv6 6to4 interface name"
			default "sit1"
			help
				"IPv6 6to4 interface name"
	endmenu
endmenu
menu "MTD partitions"
	config BOOTLOADER_PARTITION_ENABLE
		bool "Select to configure bootloader partition"
		default y
		help
			"If you want to configure bootloader partition, you should select it."

	menu "The configuration of bootloader partition"
	depends on BOOTLOADER_PARTITION_ENABLE
		config BOOTLOADER_PARTITION
			string
			prompt "Bootloader's partition"
			default "/dev/mtd0"
	endmenu

	config BOOTLOADER_ENV_PARTITION_ENABLE
		bool "Select to configure bootloader env partition"
		default y
		help
			"If you want to configure bootloader env partition, you should select it."

	menu "The configuration of bootloader env partition"
	depends on BOOTLOADER_ENV_PARTITION_ENABLE
		config BOOTLOADER_ENV_PARTITION
			string
			prompt "Bootloader ENV's partition"
			default "/dev/mtd1"
	endmenu

	config CALDATA_PARTITION_ENABLE
		bool "Select to configure caldata partition"
		default y
		help
			"If you want to configure caldata partition, you should select it."

	menu "The configuration of caldata partition"
	depends on CALDATA_PARTITION_ENABLE
		config CALDATA_PARTITION
			string
			prompt "Calibration Data's partition"
			default "/dev/mtd2"
	endmenu

	config CALDATA_BACKUP_PARTITION_ENABLE
		bool "Select to configure caldata_backup partition"
		default y
		help
			"If you want to configure caldata backup partition, you should select it."

	menu "The configuration of caldata_backup partition"
	depends on CALDATA_BACKUP_PARTITION_ENABLE
		config CALDATA_BACKUP_PARTITION
			string
			prompt "Calibration Data's back up partition"
			default "/dev/mtd2"
	endmenu

	config POT_PARTITION_ENABLE
		bool "Select to configure pot partition"
		default y
		help
			"If you want to configure pot partition, you should select it."

	menu "The configuration of pot partition"
	depends on POT_PARTITION_ENABLE
		config POT_PARTITION
			string
			prompt "POT's partition"
			default "/dev/mtd3"
	endmenu

	config LANGUAGE_PARTITION_ENABLE
		bool "Select to configure language partition"
		default y
		help
			"If you want to configure language partition, you should select it."

	menu "The configuration of language partition"
	depends on LANGUAGE_PARTITION_ENABLE
		config LANGUAGE_PARTITION
			string
			prompt "LANGUAGE TABLE's partition"
			default "/dev/mtd4"
        endmenu
	
	config CONFIGURATION_PARTITION_ENABLE	
		bool "Select to configure configuration partition"
		default y
		help
			"If you want to configure configuration partition, you should select it."

	menu "The configuration of configuration partition"
	depends on CONFIGURATION_PARTITION_ENABLE
		config CONFIGURATION_PARTITION
			string
			prompt "Configuration's partition"
			default "/dev/mtd5"
	endmenu

	config TRAFFIC_METER_PARTITION_ENABLE
		bool "Select to configure traffic meter partition"
		default y
		help
			"If you want to configure configuration partition, you should select it."

	menu "The configuration of traffic meter partition"
	depends on TRAFFIC_METER_PARTITION_ENABLE
		config TRAFFIC_METER_PARTITION
			string
			prompt "Traffic Meter's partition"
			default "/dev/mtd6"
	endmenu

	config KERNEL_PARTITION_ENABLE
		bool "Select to configure kernel partition"
		default y
		help
			"If you want to configure kernel partition, you should select it."

	menu "The configuration of kernel partition"
	depends on KERNEL_PARTITION_ENABLE
		config KERNEL_PARTITION
			string
			prompt "Kernel's partition"
			default "/dev/mtd7"
	endmenu

	config ROOTFS_PARTITION_ENABLE
		bool "Select to configure rootfs partition"
		default y
		help
			"If you want to configure rootfs partition, you should select it."

	menu "The configuration of rootfs partition"
	depends on ROOTFS_PARTITION_ENABLE
		config ROOTFS_PARTITION
			string
			prompt "Rootfs's partition"
			default "/dev/mtd8"
	endmenu

	config ROOTFS_DATA_PARTITION_ENABLE
		bool "Select to configure rootfs data partition"
		default y
		help
			"If you want to configure rootfs data partition, you should select it."

	menu "The configuration of rootfs data partition"
	depends on ROOTFS_DATA_PARTITION_ENABLE
		config ROOTFS_DATA_PARTITION
			string
			prompt "Rootfs data's partition"
			default "/dev/mtd9"
	endmenu

	config FIRMWARE_PARTITION_ENABLE
		bool "Select to configure firmware partition"
		default y
		help
			"If you want to configure firmware partition, you should select it."

	menu "The configuration of firmware partition"
	depends on FIRMWARE_PARTITION_ENABLE
		config FIRMWARE_PARTITION
			string
			prompt "Firmware's partition"
			default "/dev/mtd10"
	endmenu

	config RESERVED_PARTITION_ENABLE
		bool "Select to configure reserved partition"
		default y
		help
			"If you want to configure reserved partition, you should select it."

	menu "The configuration of reserved partition"
	depends on RESERVED_PARTITION_ENABLE
		config RESERVED_PARTITION
			string
			prompt "Reserved partition"
			default "/dev/mtd11"
	endmenu

	config NVRAM_PARTITION_ENABLE
		bool "Select to configure nvram partition"
		default y
		help
			"If you want to configure nvram partition partition, you should select it."

	menu "The configuration of nvram partition"
	depends on NVRAM_PARTITION_ENABLE
		config NVRAM_PARTITION
			string
			prompt "NVRAM partition"
			default "/dev/mtd11"
	endmenu
endmenu

config TARGET_BOARD_HW_ID
	string
	prompt "DUT's board hw ID"
	default "2976436100+128+128"
	help
		"PCB Board Number + Flash Size + RAM Size"
endmenu
```
