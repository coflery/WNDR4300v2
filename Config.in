## git_home/linux.git/net/bridge/Kconfig
```kconfig
#
# 802.1d Ethernet Bridging
#

config BRIDGE
	tristate "802.1d Ethernet Bridging"
	select LLC
	select STP
	---help---
	  If you say Y here, then your Linux box will be able to act as an
	  Ethernet bridge, which means that the different Ethernet segments it
	  is connected to will appear as one Ethernet to the participants.
	  Several such bridges can work together to create even larger
	  networks of Ethernets using the IEEE 802.1 spanning tree algorithm.
	  As this is a standard, Linux bridges will cooperate properly with
	  other third party bridge products.

	  In order to use the Ethernet bridge, you'll need the bridge
	  configuration tools; see <file:Documentation/networking/bridge.txt>
	  for location. Please read the Bridge mini-HOWTO for more
	  information.

	  If you enable iptables support along with the bridge support then you
	  turn your bridge into a bridging IP firewall.
	  iptables will then see the IP packets being bridged, so you need to
	  take this into account when setting up your firewall rules.
	  Enabling arptables support when bridging will let arptables see
	  bridged ARP traffic in the arptables FORWARD chain.

	  To compile this code as a module, choose M here: the module
	  will be called bridge.

	  If unsure, say N.

config DNI_MCAST_TO_UNICAST
	tristate "DNI_MCAST_TO_UNICAST"
	---help---
	   DNI_MCAST_TO_UNICAST

config DNI_MULTI_LAN_SUPPORT
	tristate "DNI_MULTI_LAN_SUPPORT"
	---help---
	   DNI_MULTI_LAN_SUPPORT

config BRIDGE_NETGEAR_ACL
	tristate "NETGEAR feature: block a client from accessing the network"
	---help---
	   Block a device according MAC address, If a client is blocked by this function,
	   the DHCP and ARP packet will be passed, other packet to/from local, other port will be dropped

config NTGR_GUEST_NETWORK_DHCP_LEASE
	tristate "NETGEAR feature: dhcp lease time for wireless guest network client is 30 minute"
	---help---
	   Change dhcp lease time for wireless guest network client to 30 minutes

config HYBRID_BRIDGE_SUPPORT
	bool "802.1d Ethernet Hybrid Bridging"
	select LLC
	select STP
	default n
	---help---
	  If you say Y here, then the Ethernet hybrid bridge will be enabled. It extends
	  the Ethernet bridge features, like path swithing, bridge snooping and etc.

	  [!] NOTE, It is independence with Ethernet bridge, so if you say Y here, the
	  Ethernet bridge will be disabled by this macro.

	  If unsure, say N.

config HYBRID_BRIDGE_SNOOPING
	bool "IGMP/MLD snooping"
	depends on HYBRID_BRIDGE_SUPPORT
	depends on INET
	default n
	---help---
	  If you say Y here, then the Ethernet hybrid bridge will be able selectively
	  forward multicast traffic based on IGMP/MLD traffic received from
	  each port.

	  Say N to exclude this support and reduce the binary size.

	  If unsure, say N.
```

## package/acl/Config.in
```kconfig
# dni-acl configuration

config DNI_ACL_GIT_TREEISH
	string
	prompt "treeish of dni-acl git repository"
	default "dni-acl-dni3"
	help
          Input the treeish of dni-acl git repository which you want to build

config DNI_ACL_GIT_REPOSITORY
	string
	prompt "name of dni-acl git repository"
	default "dni-acl.git"
	help
	  Input the name of dni-acl git repository which you want to build

config DNI_ACL_GIT_URL
	string
	prompt "url of dni-acl git repository"
	default "ssh://dniserver/scm/dnigit/common/apps/dni-acl.git"
	help
	  Input the url of dni-acl git repository which you want to build
```

## package/artmtd/Config.in
```kconfig
menu "ART Conofiguration"

config ART_PARTITION_LENGTH
	int "The size of art partition"
	default 262144

config MAC_OFFSET
	string	"MAC offset in art partition"
	default 0x0

config PIN_OFFSET
	string "PIN offset in art partition"
	default 24

config PIN_LENGTH
	int "The length of WPS PIN"
	default 8

config SN_OFFSET
	string  "SN offset in art partition"
	default 32

config SN_LENGTH
	int "The length of Serial Number"
	default 13

config REGION_NUMBER_OFFSET
	string "RN offset in art partition"
	default 45
	
config REGION_NUMBER_LENGTH
	int "The length of Region Number"
	default 2

config REGION_FILE
	string "The file of firmware region"
	default "/tmp/firmware_region"

config BOARD_HW_ID_OFFSET
	string "HW ID offset in art partition"
	default 47

config BOARD_HW_ID_LENGTH
	int "The length of board hardware id"
	default 16

config BOARD_MODEL_ID_OFFSET
	string "MODEL ID offset in art partition"
	default 63

config BOARD_MODEL_ID_LENGTH
	int "The length of board model id"
	default 10

config MAX_SSID_OFFSET
	string "SSID offset in art partition"
	default 73

config MAX_SSID_LEN
	int "The max length of SSID"
	default 32

config MAX_PSSPHRS_OFFSET
	string "PASSPHRASE offset in art partition"
	default 105

config MAX_PSSPHRS_LEN
	int "The max length of passphase"
	default 64

config CAL_OFFSET
	string "The atheros art data offset in ART partition"
	default 0x1200

endmenu

menu "Language Configurations"

config LANGUAGE_COUNT
	int "The number of language table"
	default 10

config LANGUAGE_SIZE
	int "The size of language table"
	default 131072

endmenu

menu "BACKUP Configurations"

config BACKUP_OFFSET
	int "The data offset in backup partition"
	default 0

endmenu
```

## package/atheros-aquila-madwifi-11n-scripts/Config.in
```kconfig
# MadWifi configuration

config ATHEROS_AQUILA_SCRIPT_GIT_TREEISH
	string
	prompt "treeish of atheros aquila script git repository"
	default "madwifi-11n-scripts-aquila-dni95"
	help
	  Input the treeish of atheros aquila git repository which you want to build

config ATHEROS_AQUILA_SCRIPT_GIT_REPOSITORY
	string
	prompt "name of atheros aquila script git repository"
	default "madwifi-11n-scripts.git"
	help
	  Input the name of atheros aquila git repository which you want to build

config ATHEROS_AQUILA_SCRIPT_GIT_URL
	string
	prompt "url of atheros aquila script git repository"
	default "ssh://dniserver/scm/dnigit/common/apps/madwifi-11n-scripts.git"
	help
	  Input the url of atheros aquila git repository which you want to build

choice
	prompt "Select the type of board type"
	depends on PACKAGE_atheros-aquila-madwifi-11n-scripts
	default ATHEROS_AQUILA_SCRIPT_TYPE_DNI
	help
	  This option control the board type will be used by the script

config ATHEROS_AQUILA_SCRIPT_TYPE_DNI
	bool "Use DNI merged script type"
	help
          This is to use DNI merged script type

config ATHEROS_AQUILA_SCRIPT_TYPE_SINGLE
	bool "Use Atheros single board script"
	help
          This is to use Atheros Aquila single board script

config ATHEROS_AQUILA_SCRIPT_TYPE_DUAL
	bool "Use Atheros dual board script"
	help
          This is to use Atheros Aquila dual board script

endchoice

config ATHEROS_AQUILA_SCRIPT_USE_BOARD
       string "Designate Atheros platform which is used for this project"
       depends on PACKAGE_atheros-aquila-madwifi-11n-scripts
       default ""
       help
         Different Atheros platform has different configuration file,
         so the Atheros platform must be designated for installing
         corresponding configuration file. If you don't know which
         Atheros platfrom should be used for your project, please
         contact with module administrator for more information.

config ATHEROS_AQUILA_SCRIPT_READONLY_FS
       bool "Is rootfs readonly?"
       depends on PACKAGE_atheros-aquila-madwifi-11n-scripts
       default n
       help
        If rootfs is readonly, we need to copy Atheros scripts to another folder
        to link /etc/ath to ramdisk to ensure /etc/ath and /etc/wpa2 are writable.

choice
	prompt "Select the source of configuration system"
	depends on PACKAGE_atheros-aquila-madwifi-11n-scripts
	default ATHEROS_AQUILA_SCRIPT_DNI_CONFIG
	help
	  This option control the source of configuration system

config ATHEROS_AQUILA_SCRIPT_DNI_CONFIG
	bool "Use DNI datalib configuration system"
	depends on PACKAGE_datalib
	help
          This is to use DNI configuration system (datalib)

config ATHEROS_AQUILA_SCRIPT_OPENWRT_CONFIG
	bool "Use Openwrt configuration system"
	help
          This is to use Openwrt configuration system

endchoice

config ATHEROS_AQUILA_PLATFORM_PATCH
       bool "Apply platform specific patch"
       depends on PACKAGE_atheros-aquila-madwifi-11n-scripts
       default n

config ATHEROS_AQUILA_SCRIPT_WSC_MANUFACTURER
       string "The name of manufacturer used by WPS"
       depends on PACKAGE_atheros-aquila-madwifi-11n-scripts
       default "none"

config ATHEROS_AQUILA_SCRIPT_WSC_MODEL_NAME
       string "The model name used by WPS"
       depends on PACKAGE_atheros-aquila-madwifi-11n-scripts
       default "none"

config ATHEROS_AQUILA_SCRIPT_WSC_MODEL_NUMBER
       string "The model number used by WPS"
       depends on PACKAGE_atheros-aquila-madwifi-11n-scripts
       default "none"

config ATHEROS_AQUILA_SCRIPT_IPTV_SUPPORT
	bool "Support WLAN IPTV function"
	default n
```

## package/atheros-aquila-madwifi/Config.in
```kconfig
# MadWifi configuration

menu "Configurations"

config ATHEROS_MADWIFI_GIT_TREEISH
	string
	prompt "treeish of atheros madwifi git repository"
	default "madwifi-11n-aquila-dni43"
	help
	  Input the treeish of atheros-aquila-madwifi git repository which you want to build

config ATHEROS_MADWIFI_GIT_REPOSITORY
	string
	prompt "name of atheros madwifi git repository"
	default "madwifi-11n.git"
	help
	  Input the name of atheros-aquila-madwifi git repository which you want to build

config ATHEROS_MADWIFI_GIT_URL
	string
	prompt "url of atheros madwifi git repository"
	default "ssh://dniserver/scm/dnigit/vendor/atheros/madwifi-11n/spencer/madwifi-11n.git"
     	help
	  Input the url of atheros-aquila-madwifi git repository which you want to build

config ATHEROS_MADWIFI_SUPPORT_DFS
	bool "Enable DFS"
	depends on PACKAGE_kmod-atheros-aquila-madwifi
	default n

config ATHEROS_MADWIFI_SUPPORT_MCAST_ENHANCEMENT
	bool "Enable IEEE80211 Multicast Enhancement"
	depends on PACKAGE_kmod-atheros-aquila-madwifi
	default y

config ATHEROS_MADWIFI_SUPPORT_SW_CRYPTO
	bool "Enable Software crypto"
	depends on PACKAGE_kmod-atheros-aquila-madwifi
	default y

config ATHEROS_MADWIFI_SUPPORT_BUILD_OPTIMIZED
	bool "Enable Building optimization"
	depends on PACKAGE_kmod-atheros-aquila-madwifi
	default y

config ATHEROS_MADWIFI_SUPPORT_HORNET
	bool "Support Atheros HORNET chip"
	depends on PACKAGE_kmod-atheros-aquila-madwifi
	default n

config ATHEROS_MADWIFI_SUPPORT_AR9300
	bool "Support Atheros AR9300 chip"
	depends on PACKAGE_kmod-atheros-aquila-madwifi
	default n

config ATHEROS_MADWIFI_SUPPORT_IQUE
	bool "Support Atheros iQueue feature"
	depends on PACKAGE_kmod-atheros-aquila-madwifi
	default y

config ATHEROS_MADWIFI_SUPPORT_IQUE_EXT
	bool "Support Atheros iQueue EXT feature"
	depends on PACKAGE_kmod-atheros-aquila-madwifi
	default y

config ATHEROS_MADWIFI_SUPPORT_PAPRD
	bool "Support Atheros PAPRD feature"
	depends on PACKAGE_kmod-atheros-aquila-madwifi
	default n

config ATHEROS_MADWIFI_NO_5G_SUPPORT
	bool "Disable 5G support"
	depends on PACKAGE_kmod-atheros-aquila-madwifi
	default y

config ATHEROS_MADWIFI_SUPPORT_PKTLOG
	bool "Enable Atheros packet log"
	depends on PACKAGE_kmod-atheros-aquila-madwifi
	default y

config ATHEROS_MADWIFI_SUPPORT_RPTPLACEMENT
	bool "Support repeater placement"
	depends on PACKAGE_kmod-atheros-aquila-madwifi
	default y

config ATHEROS_MADWIFI_RADIOS
       int "Number of RADIO"
       depends on PACKAGE_kmod-atheros-aquila-madwifi && !TARGET_wndr4500v3
       default 1

config ATHEROS_MADWIFI_CAL_LOCATIONS
       string "Calibration Address"
       depends on PACKAGE_kmod-atheros-aquila-madwifi && !TARGET_wndr4500v3
       default 0xbfff1000

config ATHEROS_MADWIFI_CAL_LOCATIONS_PCI
       string "Calibration Address for PCI"
       depends on PACKAGE_kmod-atheros-aquila-madwifi && TARGET_wndr4500v3
       default 0xbfff1000

config ATHEROS_MADWIFI_CAL_LOCATIONS_AHB
       string "Calibration Address for AHB"
       depends on PACKAGE_kmod-atheros-aquila-madwifi && TARGET_wndr4500v3
       default 0xbfff0000

config ATHEROS_MADWIFI_READ_2G_MAC_ADDR
       bool "Read 2.4G MAC address from specified location in flash"
       depends on PACKAGE_kmod-atheros-aquila-madwifi
       default n

config ATHEROS_MADWIFI_2G_MAC_ADDR_LOC
       string "Read 2.4G MAC address from ..."
       depends on PACKAGE_kmod-atheros-aquila-madwifi
       depends ATHEROS_MADWIFI_READ_2G_MAC_ADDR
       default 0xbfff1000

config ATHEROS_MADWIFI_READ_5G_MAC_ADDR
       bool "Read 5G MAC address from specified location in flash"
       depends on PACKAGE_kmod-atheros-aquila-madwifi
       default n

config ATHEROS_MADWIFI_5G_MAC_ADDR_LOC
       string "Read 5G MAC address from ..."
       depends on PACKAGE_kmod-atheros-aquila-madwifi
       depends ATHEROS_MADWIFI_READ_5G_MAC_ADDR
       default 0xbfff5000

config ATHEROS_MADWIFI_SUPPORT_VOWEXT
       bool "enable ATH_SUPPORT_VOWEXT"
       depends on PACKAGE_kmod-atheros-aquila-madwifi
       default n

config ATHEROS_MADWIFI_SUPPORT_VOW_EXT_STATS
       bool "enable ATH_VOW_EXT_STATS"
       depends on PACKAGE_kmod-atheros-aquila-madwifi
       default n

config ATHEROS_MADWIFI_SUPPORT_VOW_TIDSCHED
       bool "enable VOW_TIDSCHED"
       depends on PACKAGE_kmod-atheros-aquila-madwifi
       default n

config ATHEROS_MADWIFI_SUPPORT_VOW_LOGLATENCY
       bool "enable VOW_LOGLATENCY"
       depends on PACKAGE_kmod-atheros-aquila-madwifi
       default n

config ATHEROS_MADWIFI_SUPPORT_CFEND
       bool "enable ATH_SUPPORT_CFEND"
       depends on PACKAGE_kmod-atheros-aquila-madwifi
       default n

config ATHEROS_MADWIFI_SUPPORT_DESCFAST
       bool "enable ATH_SUPPORT_DESCFAST"
       depends on PACKAGE_kmod-atheros-aquila-madwifi
       default n

config ATHEROS_MADWIFI_SUPPORT_TDLS
       bool "enable ATH_SUPPORT_TDLS"
       depends on PACKAGE_kmod-atheros-aquila-madwifi
       default n

config ATHEROS_MADWIFI_SUPPORT_GREEN_AP
       bool "enable Green AP (ATH_SUPPORT_GREEN_AP)"
       depends on PACKAGE_kmod-atheros-aquila-madwifi
       default n

config ATHEROS_MADWIFI_SUPPORT_AR5416_INT_MITIGATION
       bool "enable ATH_SUPPORT_AR5416_INT_MITIGATION"
       depends on PACKAGE_kmod-atheros-aquila-madwifi
       default n

config ATHEROS_MADWIFI_SUPPORT_CAP_AMSDU
       bool "enable AMSDU capability (ATH_CAP_AMSDU)"
       depends on PACKAGE_kmod-atheros-aquila-madwifi
       default n

config ATHEROS_MADWIFI_SUPPORT_HOWL
       bool "enable HOWL support"
       depends on PACKAGE_kmod-atheros-aquila-madwifi
       default n

config ATHEROS_MADWIFI_PLATFORM_PATCH
       bool "Apply platform specific patch"
       depends on PACKAGE_kmod-atheros-aquila-madwifi
       default n

config ATHEROS_MADWIFI_RXBUF
       int "Number of receive buffer"
       depends on PACKAGE_kmod-atheros-aquila-madwifi
       default 512

config ATHEROS_MADWIFI_TXBUF
       int "Number of transmission buffer"
       depends on PACKAGE_kmod-atheros-aquila-madwifi
       default 512

config ATHEROS_MADWIFI_USE_CLIENT_BRIDGE
	bool "Use client bridge feature"
	depends on PACKAGE_kmod-atheros-aquila-madwifi
	default n

config ATHEROS_MADWIFI_DISPLAY_SCAN_IN_PROC
	bool "Display scan result in proc system"
	depends on PACKAGE_kmod-atheros-aquila-madwifi
	default n

endmenu
```
