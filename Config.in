## package/atheros-aquila-wpa2/Config.in
```kconfig
# Atheros hostap configuration

config ATHEROS_AQUILA_WPA_GIT_TREEISH
	string
	prompt "treeish of atheros aquila wpa git repository"
	default "hostapd-aquila-dni15"
	help
	  Input the treeish of atheros aquila wpa git repository which you want to build

config ATHEROS_AQUILA_WPA_GIT_REPOSITORY
	string
	prompt "name of atheros aquila wpa git repository"
	default "hostap.git"
	help
	  Input the name of atheros aquila wpa git repository which you want to build

config ATHEROS_AQUILA_WPA_GIT_URL
	string
	prompt "url of atheros aquila wpa git repository"
	default "ssh://dniserver/scm/dnigit/common/apps/hostap.git"
	help
	  Input the url of atheros aquila wpa git repository which you want to build

config ATHEROS_AQUILA_WPA_ATHR_HOSTAP
	bool "Use Atheros latest hostap package"
	help
	  This is to use Atheros latest hostap package, which is derived
	  from the original hostap in w1.fi.

config ATHEROS_AQUILA_WPA_HOSTAPD
	depends on ATHEROS_AQUILA_WPA_ATHR_HOSTAP
	default y
	bool "Install hostapd"

config ATHEROS_AQUILA_WPA_WPASUPPLICANT
	depends on ATHEROS_AQUILA_WPA_ATHR_HOSTAP
	default n
	bool "Install wpa_supplicant"
```

## package/atheros-enet/Config.in
```kconfig
# Atheros ethernet driver configuration
config ATHEROS_ENET_GIT_URL
	string
	prompt "url of atheros-enet git repository"
	default "ssh://dniserver/scm/dnigit/vendor/atheros/atheros-enet/vincent.yang/atheros-enet.git"
	help
	   Input the url of atheros-enet git repository which you want to build

config ATHEROS_ENET_GIT_REPOSITORY
	string
	prompt "name of atheros-enet git repository"
	default "atheros-enet.git"
	help
	   Input the name of atheros-enet git repository which you want to build

config ATHEROS_ENET_GIT_TREEISH
	string
	prompt "treeish of atheros-enet git repository"
	default "atheros-enet-v9.2.0.1017-dni37"
	help
	   Input the treeish of atheros-enet git repository which you want to build

config ATHEROS_ENET_BOARD
	string "Board that atheros-enet embedded"
	default "db120-wndr3700v4"

config ATHEROS_ENET_DNI_SIOCGMIIREG
	bool "support DNI_SIOCGMIIREG."
	default n

config ATHEROS_ENET_DNI_DEFAULT_MAC
	bool "support DNI_DEFAULT_MAC."
	default n

config ATHEROS_ENET_DNI_SWITCH_PHY
	bool "support DNI_SWITCH_PHY."
	default n

config ATHEROS_ENET_DNI_ETH_LED
	bool "support DNI_ETH_LED."
	default n

config ATHEROS_ENET_DNI_QOS
	bool "support DNI_ETH_QOS."
	default n
```

## package/datalib/Config.in
```kconfig
# datalib configuration

config DNI_DATALIB_GIT_TREEISH
	string
	prompt "treeish of dni datalib git repository"
	default "datalib-dni3"
	help
          Input the treeish of dni datalib git repository which you want to build

config DNI_DATALIB_GIT_REPOSITORY
	string
	prompt "name of dni datalib git repository"
	default "datalib.git"
	help
	  Input the name of dni datalib git repository which you want to build

config DNI_DATALIB_GIT_URL
	string
	prompt "url of dni datalib git repository"
	default "ssh://dniserver/scm/dnigit/common/apps/datalib.git"
	help
	  Input the url of dni datalib git repository which you want to build

config DATALIB_MAGIC
	string "Datalib Magic Number"
	default 0x20080724

config DATALIB_SPACE
	string "Datalib config space"
	default 0x20000
```

## package/detwan/Config.in
```kconfig
config DNI_DETWAN_GIT_TREEISH
	string
	prompt "treeish of dni detwan git repository"
	default "wan-detection-dni27"
	help
           Input the treeish of dni detwan git repository which you want to build

config DNI_DETWAN_GIT_REPOSITORY
	string
	prompt "name of dni detwan git repository"
	default "wan-detection.git"
	help
	   Input the name of dni detwan git repository which you want to build

config DNI_DETWAN_GIT_URL
	string
	prompt "url of dni detwan git repository"
	default "ssh://dniserver/scm/dnigit/common/apps/wan-detection.git"
	help
	   Input the url of dni detwan git repository which you want to build
```

## package/dni-dmapool/Config.in
```kconfig
# dni-dmapool configuration
config DNIDMAPOOL_GIT_TREEISH
	string
	prompt "treeish of dni-dmapoll git repository"
	default "877466ae28d7706e35a73b75a11931d6adfaaf9f"
	help
           Input the treeish of dni-dmapoll git repository which you want to build

config DNIDMAPOLL_GIT_REPOSITORY
        string
        prompt "name of dni-dmapool git repository"
        default "dni-dmapool.git"
        help
           Input the name of dni-dmapool git repository which you want to build

config DNIDMAPOLL_GIT_URL
        string
        prompt "url of dni-dmapool git repository"
        default "ssh://dniserver/scm/dnigit/common/kmods/dni-dmapool.git"
        help
           Input the url of dni-dmapool git repository which you want to build
```

## package/dni-ntpclient/Config.in
```kconfig
config NTPCLIENT_GIT_TREEISH
	string
	prompt "treeish of dni-ntpclient git repository"
	default "ntpclient_2003_194-dni33"
	help
           Input the treeish of dni-ntpclient git repository which you want to build

config NTPCLIENT_GIT_REPOSITORY
	string
	prompt "name of dni-ntpclient git repository"
	default "ntpclient.git"
	help
	   Input the name of dni-ntpclient git repository which you want to build

config NTPCLIENT_GIT_URL
	string
	prompt "url of dni-ntpclient git repository"
	default "dniserver/scm/dnigit/common/apps/ntpclient.git"
	help
	   Input the url of dni-ntpclient git repository which you want to build
```

## package/dni-ripd/Config.in
```kconfig
config DNI_RIPD_GIT_TREEISH
	string
	prompt "treeish of dni ripd git repository"
	default "dni-rip-v1.0-dni25"
	help
           Input the treeish of dni ripd git repository which you want to build

config DNI_RIPD_GIT_REPOSITORY
	string
	prompt "name of dni ripd git repository"
	default "dni-ripd.git"
	help
	   Input the name of dni ripd git repository which you want to build

config DNI_RIPD_GIT_URL
	string
	prompt "url of dni ripd git repository"
	default "ssh://dniserver/scm/dnigit/common/apps/dni-ripd.git"
	help
	   Input the url of dni ripd git repository which you want to build
```

## package/dnibusybox/Config.in
```kconfig
config DNI_BUSYBOX_GIT_TREEISH
	string
	prompt "treeish of dni busybox git repository"
	default "busybox-v1.4.2-dni65"
	help
           Input the treeish of dni busybox git repository which you want to build

config DNI_BUSYBOX_GIT_REPOSITORY
	string
	prompt "name of dni busybox git repository"
	default "busybox.git"
	help
	   Input the name of dni busybox git repository which you want to build

config DNI_BUSYBOX_GIT_URL
	string
	prompt "url of dni busybox git repository"
	default "ssh://dniserver/scm/dnigit/common/apps/busybox.git"
	help
	   Input the url of dni busybox git repository which you want to build
```

## package/dnippp/Config.in
```kconfig
config DNI_PPP_GIT_TREEISH
	string
	prompt "treeish of dni ppp git repository"
	default "ppp-v2.4.3-dni29"
	help
           Input the treeish of dni ppp git repository which you want to build

config DNI_PPP_GIT_REPOSITORY
	string
	prompt "name of dni ppp git repository"
	default "ppp.git"
	help
	   Input the name of dni ppp git repository which you want to build

config DNI_PPP_GIT_URL
	string
	prompt "url of dni ppp git repository"
	default "ssh://dniserver/scm/dnigit/common/apps/ppp.git"
	help
	   Input the url of dni ppp git repository which you want to build
```

## package/dns-ipupdate/Config.in
```kconfig
config DNS_IPUPDATE_GIT_TREEISH
	string
	prompt "treeish of dni dns-ipupdate git repository"
	default "dns-ipupdate-v1.0.0-dni8"
	help
           Input the treeish of dni dns-ipupdate git repository which you want to build

config DNS_IPUPDATE_GIT_REPOSITORY
	string
	prompt "name of dni dns-ipupdate git repository"
	default "dns-ipupdate.git"
	help
	   Input the name of dni dns-ipupdate git repository which you want to build

config DNS_IPUPDATE_GIT_URL
	string
	prompt "url of dni dns-ipupdate git repository"
	default "ssh://dniserver/scm/dnigit/common/apps/dns-ipupdate.git"
	help
	   Input the url of dni dns-ipupdate git repository which you want to build
```

## package/ez-ipupdate/Config.in
```kconfig
config EZ_IPUPDATE_GIT_TREEISH
	string
	prompt "treeish of dni ez-ipupdate git repository"
	default "ez-ipupdate-v3.0.10-dni21"
	help
           Input the treeish of dni ez-ipupdate git repository which you want to build

config EZ_IPUPDATE_GIT_REPOSITORY
	string
	prompt "name of dni ez-ipupdate git repository"
	default "ez-ipupdate.git"
	help
	   Input the name of dni ez-ipupdate git repository which you want to build

config EZ_IPUPDATE_GIT_URL
	string
	prompt "url of dni ez-ipupdate git repository"
	default "dniserver/scm/dnigit/common/apps/ez-ipupdate.git"
	help
	   Input the url of dni ez-ipupdate git repository which you want to build
```

## package/kmod-conenat/Config.in
```kconfig
# kmod-conenat configuration
config CONENAT_GIT_TREEISH
	string
	prompt "treeish of conenat git repository"
	default "kmod-conenat-v2.0.2"
	help
           Input the treeish of conenat git repository which you want to build

config CONENAT_GIT_REPOSITORY
        string
        prompt "name of conenat git repository"
        default "kmod-conenat.git"
        help
           Input the name of conenat git repository which you want to build

config CONENAT_GIT_URL
        string
        prompt "url of conenat git repository"
        default "ssh://dniserver/scm/dnigit/common/kmods/kmod-conenat.git"
        help
           Input the url of conenat git repository which you want to build
```

## package/kmod-dni-qos/Config.in
```kconfig
# kmod-dni-qos configuration
config DNI_QOS_GIT_TREEISH
	string
	prompt "treeish of dni-qos git repository"
	default "qos-new-dni11"
	help
           Input the treeish of dni-qos git repository which you want to build

config DNI_QOS_GIT_REPOSITORY
	string
	prompt "name of dni-qos git repository"
	default "kmod-dni-qos.git"
	help
	   Input the name of dni-qos git repository which you want to build

config DNI_QOS_GIT_URL
	string
	prompt "url of dni-qos git repository"
	default "dniserver/scm/dnigit/common/kmods/kmod-dni-qos.git"
	help
	   Input the url of dni-qos git repository which you want to build
```

## package/kmod-dnih323/Config.in
```kconfig
# kmod-dnih323 configuration
config DNIH323_GIT_TREEISH
	string
	prompt "treeish of DNIH323 git repository"
	default "alg-h323-v2.6.31-dni2"
	help
           Input the treeish of kmod-dnih323 git repository which you want to build

config DNIH323_GIT_REPOSITORY
	string
	prompt "name of DNIH323 git repository"
	default "kmod-dnih323.git"
	help
	   Input the name of kmod-dnih323 git repository which you want to build

config DNIH323_GIT_URL
	string
	prompt "url of DNIH323 git repository"
	default "ssh://dniserver/scm/dnigit/common/kmods/kmod-dnih323.git"
	help
	   Input the url of kmod-dnih323 git repository which you want to build
```

## package/kmod-dnirtsp/Config.in
```kconfig
# kmod-dnirtsp configuration
config DNIRTSP_GIT_TREEISH
	string
	prompt "treeish of DNIRTSP git repository"
	default "alg-rtsp-v2.6.31-dni4"
	help
           Input the treeish of dnirtsp git repository which you want to build

config DNIRTSP_GIT_REPOSITORY
	string
	prompt "name of DNIRTSP git repository"
	default "kmod-dnirtsp.git"
	help
           Input the name of dnirtsp git repository which you want to build

config DNIRTSP_GIT_URL
	string
	prompt "url of DNIRTSP git repository"
	default "ssh://dniserver/scm/dnigit/common/kmods/kmod-dnirtsp.git"
	help
           Input the url of dnirtsp git repository which you want to build
```

## package/kmod-dnisip/Config.in
```kconfig
# kmod-dnisip configuration
config DNISIP_GIT_TREEISH
	string
	prompt "treeish of dnisip git repository"
	default "alg-sip-v2.6.31-dni4"
	help
           Input the treeish of dnisip git repository which you want to build

config DNISIP_GIT_REPOSITORY
	string
	prompt "name of dnisip git repository"
	default "kmod-dnisip.git"
	help
	   Input the name of dnisip git repository which you want to build

config DNISIP_GIT_URL
	string
	prompt "url of dnisip git repository"
	default "ssh://dniserver/scm/dnigit/common/kmods/kmod-dnisip.git"
	help
	   Input the url of dnisip git repository which you want to build
```

## package/kmod-dnshijack/Config.in
```kconfig
# kmod-dnshijack configuration
config DNSHIJACK_GIT_TREEISH
	string
	prompt "treeish of dnshijack git repository"
	default "kmod-dnshijack-v2.6.31-dni2"
	help
           Input the treeish of dnshijack git repository which you want to build

config DNSHIJACK_GIT_REPOSITORY
	string
	prompt "name of dnshijack git repository"
	default "kmod-dnshijack.git"
	help
	   Input the name of dnshijack git repository which you want to build

config DNSHIJACK_GIT_URL
	string
	prompt "url of dnshijack git repository"
	default "ssh://dniserver/scm/dnigit/common/kmods/kmod-dnshijack.git"
	help
	   Input the url of dnshijack git repository which you want to build
```

## package/kmod-ftp-alg/Config.in
```kconfig
# kmod-ftp-alg configuration
config FTP_ALG_GIT_TREEISH
	string
	prompt "treeish of kmod-ftp-alg git repository"
	default "kmod-ftp-v2.6.31-dni5"
	help
           Input the treeish of kmod-ftp-alg git repository which you want to build

config FTP_ALG_GIT_REPOSITORY
        string
        prompt "name of kmod-ftp-alg git repository"
        default "kmod-ftp.git"
        help
           Input the name of kmod-ftp-alg git repository which you want to build

config FTP_ALG_GIT_URL
        string
        prompt "url of kmod-ftp-alg git repository"
        default "ssh://dniserver/scm/dnigit/common/kmods/kmod-ftp.git"
        help
           Input the url of kmod-ftp-alg git repository which you want to build
```

## package/kmod-ipsec-alg/Config.in
```kconfig
# kmod-ipsec-alg configuration
config IPSEC_ALG_GIT_TREEISH
	string
	prompt "treeish of ipsec-alg git repository"
	default "kmod-ipsec-alg-v2.6.31-dni4"
	help
           Input the treeish of ipsec-alg git repository which you want to build

config IPSEC_ALG_GIT_REPOSITORY
	string
	prompt "name of ipsec-alg git repository"
	default "kmod-ipsec-alg.git"
	help
	   Input the name of ipsec-alg git repository which you want to build

config IPSEC_ALG_GIT_URL
	string
	prompt "url of ipsec-alg git repository"
	default "ssh://dniserver/scm/dnigit/common/kmods/kmod-ipsec-alg.git"
	help
	   Input the url of ipsec-alg git repository which you want to build
```
