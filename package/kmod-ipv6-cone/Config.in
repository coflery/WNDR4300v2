## package/pot/Config.in
```kconfig
# pot configuration

config POT_GIT_TREEISH
	string "treeish of pot git repository"
	default "pot-v1.0.5"
	depends NOR_FLASH 
	help
	     Input the treeish of pot git repository which you want to build

config POT_GIT_REPOSITORY
	string "name of pot git repository"
	default "pot.git"
	depends NOR_FLASH
	help
	     Input the name of pot git repository which you want to build

config POT_GIT_URL
	string "url of pot git repository"
	default "ssh://dniserver/scm/dnigit/common/apps/pot.git"
	depends NOR_FLASH
	help
	     Input the url of pot git repository which you want to build
```

## package/proftpd/Config.in
```kconfig
config PROFTPD_GIT_TREEISH
	string
	prompt "treeish of proftpd git repository"
	default "proftpd-1.3.3-dni-09"
	help
           Input the treeish of proftpd git repository which you want to build

config PROFTPD_GIT_REPOSITORY
	string
	prompt "name of proftpd git repository"
	default "proftpd.git"
	help
	   Input the name of proftpd git repository which you want to build

config PROFTPD_GIT_URL
	string
	prompt "url of proftpd git repository"
	default "ssh://dniserver/scm/dnigit/common/apps/proftpd.git"
	help
	   Input the url of proftpd git repository which you want to build
```

## package/radvd/Config.in
```kconfig
# radvd configurations 

config RADVD_GIT_TREEISH
	string
	prompt "treeish of radvd git repository"
	default "radvd-1.5-dni11"
	help
           Input the treeish of radvd git repository which you want to build

config RADVD_GIT_REPOSITORY
	string
	prompt "name of radvd git repository"
	default "radvd.git"
	help
	   Input the name of radvd git repository which you want to build

config RADVD_GIT_URL
	string
	prompt "url of radvd git repository"
	default "ssh://dniserver/scm/dnigit/common/apps/radvd.git"
	help
           Input the url of radvd git repository which you want to build
```

## package/samba/Config.in
```kconfig
config SAMBA_GIT_TREEISH
	string
	prompt "treeish of samba git repository"
	default "samba-v3.0.24-dni5"
	help
           Input the treeish of samba git repository which you want to build

config SAMBA_GIT_REPOSITORY
	string
	prompt "name of samba git repository"
	default "samba.git"
	help
	   Input the name of samba git repository which you want to build

config SAMBA_GIT_URL
	string
	prompt "url of samba git repository"
	default "ssh://dniserver/scm/dnigit/common/apps/samba.git"
	help
	   Input the url of samba git repository which you want to build
```
