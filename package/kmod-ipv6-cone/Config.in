## package/kmod-ipv6-cone/Config.in
```kconfig
# kmod-ipv6-cone configuration
config IPV6_CONE_GIT_TREEISH
	string
	prompt "treeish of ipv6-cone git repository"
	default "kmod-ipv6-cone-v1.0.1-dni8"
	help
           Input the treeish of ipv6-cone git repository which you want to build

config IPV6_CONE_GIT_REPOSITORY
        string
        prompt "name of ipv6-cone git repository"
        default "kmod-ipv6-cone.git"
        help
           Input the name of ipv6-cone git repository which you want to build

config IPV6_CONE_GIT_URL
        string
        prompt "url of ipv6-cone git repository"
        default "ssh://dniserver/scm/dnigit/common/kmods/kmod-ipv6-cone.git"
        help
           Input the url of ipv6-cone git repository which you want to build
```

## package/kmod-l2tp/Config.in
```kconfig
# kmod-l2tp configuration
config L2TP_GIT_TREEISH
	string
	prompt "treeish of kmod-l2tp git repository"
	default "l2tp-drv-v2.6.31-dni1"
	help
           Input the treeish of l2tp git repository which you want to build

config L2TP_GIT_REPOSITORY
	string
	prompt "kmod-l2tp git repository"
	default "kmod-drv-l2tp.git"
	help
	  Input the name l2tp git repository which you want to build

config L2TP_GIT_URL
	string
	prompt "kmod-l2tp git url"
	default "ssh://dniserver/scm/dnigit/common/kmods/kmod-drv-l2tp.git"
	help
	  Input the url l2tp git repository which you want to build
```

## package/kmod-nat2.5/Config.in
```kconfig
config NAT_GIT_TREEISH
	string
	prompt "treeish of dni-nat2.5 git repository"
	default "nat2.5-dni7"
	help
           Input the treeish of dni-nat2.5 git repository which you want to build

config NAT_GIT_REPOSITORY
	string
	prompt "name of dni-nat2.5 git repository"
	default "dni-nat2.5.git"
	help
	   Input the name of dni-nat2.5 git repository which you want to build

config NAT_GIT_URL
	string
	prompt "url of dni-nat2.5 git repository"
	default "ssh://dniserver/scm/dnigit/common/kmod/dni-nat2.5.git"
	help
	  Input the url of dni-nat2.5 git repository which you want to build
```

## package/kmod-netgear-reject/Config.in
```kconfig
# kmod-netgear-reject configuration
config NETGEAR_REJECT_GIT_TREEISH
	string
	prompt "treeish of kmod-netgear-reject git repository"
	default "v2.6.31-dni2"
	help
           Input the treeish of kmod-netgear-reject git repository which you want to build

config NETGEAR_REJECT_GIT_REPOSITORY
	string
	prompt "name of kmod-netgear-reject git repository"
	default "kmod-netgear-reject.git"
	help
	   Input the name of kmod-netgear-reject git repository which you want to build

config NETGEAR_REJECT_GIT_URL
	string
	prompt "url of kmod-netgear-reject git repository"
	default "ssh://dniserver/scm/dnigit/common/kmods/kmod-netgear-reject.git"
	help
	   Input the url of kmod-netgear-reject git repository which you want to build
```

## package/kmod-pptp-alg/Config.in
```kconfig
# kmod-pptp-alg configuration
config PPTP_ALG_GIT_TREEISH
	string
	prompt "treeish of pptp-alg git repository"
	default "alg-pptp-v2.6.31-dni3"
	help
           Input the treeish of kmod-pptp-alg git repository which you want to build

config PPTP_ALG_GIT_REPOSITORY
	string
	prompt "name of pptp-alg git repository"
	default "kmod-pptp.git"
	help
	   Input the name of kmod-pptp-alg git repository which you want to build

config PPTP_ALG_GIT_URL
	string
	prompt "url of pptp-alg git repository"
	default "ssh://dniserver/scm/dnigit/common/kmods/kmod-pptp.git"
	help
	   Input the url of kmod-pptp-alg git repository which you want to build
```

## package/kmod-pptp/Config.in
```kconfig
# kmod-pptp configuration
config PPTP_GIT_TREEISH
	string
	prompt "treeish of pptp git repository"
	default "pptp-drv-v2.6.31-dni3"
	help
           Input the treeish of kmod-pptp git repository which you want to build

config PPTP_GIT_REPOSITORY
	string
	prompt "name of pptp git repository"
	default "kmod-drv-pptp.git"
	help
	   Input the name of kmod-pptp git repository which you want to build

config PPTP_GIT_URL
	string
	prompt "url of pptp git repository"
	default "ssh://dniserver/scm/dnigit/common/kmods/kmod-drv-pptp.git"
	help
	   Input the url of kmod-pptp git repository which you want to build
```

## package/kmod-spiadvdos/Config.in
```kconfig
# kmod-spiadvdos configuration
config SPIADVDOS_GIT_TREEISH
	string
	prompt "treeish of spiadvdos git repository"
	default "kmod-spiadvdos-v2.6.31-dni2"
	help
           Input the treeish of kmod-spiadvdos git repository which you want to build

config SPIADVDOS_GIT_REPOSITORY
	string
	prompt "name of spiadvdos git repository"
	default "kmod-spiadvdos.git"
	help
	   Input the name of kmod-spiadvdos git repository which you want to build

config SPIADVDOS_GIT_URL
	string
	prompt "url of spiadvdos git repository"
	default "ssh://dniserver/scm/dnigit/common/kmods/kmod-spiadvdos.git"
	help
	   Input the url of kmod-spiadvdos git repository which you want to build
```

## package/kmod-spidos/Config.in
```kconfig
# kmod-spidos configuration
config SPIDOS_GIT_TREEISH
	string
	prompt "treeish of spidos git repository"
	default "kmod-spidos-dni5"
	help
           Input the treeish of kmod-spidos git repository which you want to build

config SPIDOS_GIT_REPOSITORY
	string
	prompt "name of spidos git repository"
	default "kmod-spidos.git"
	help
	   Input the name of kmod-spidos git repository which you want to build

config SPIDOS_GIT_URL
	string
	prompt "url of spidos git repository"
	default "ssh://dniserver/scm/dnigit/common/kmods/kmod-spidos.git"
	help
	   Input the url of kmod-spidos git repository which you want to build
```

## package/kmod-starcraft/Config.in
```kconfig
config DNISTARCRAFT_ALG_GIT_TREEISH
	string
	prompt "treeish of kmod-dnistarcraft-alg git repository"
	default "alg-starcraft-v2.6.31-dni2"
	help
           Input the treeish of kmod-starcraft git repository which you want to build

config DNISTARCRAFT_ALG_GIT_REPOSITORY
	string
	prompt "name of kmod-dnistarcraft-alg git repository"
	default "kmod-starcraft.git"
	help
	   Input the name of kmod-starcraft git repository which you want to build

config DNISTARCRAFT_ALG_GIT_URL
	string
	prompt "url of kmod-dnistarcraft-alg git repository"
	default "ssh://dniserver/scm/dnigit/common/kmods/kmod-starcraft.git"
	help
	   Input the url of kmod-starcraft git repository which you want to build
```

## package/kmod-trigger/Config.in
```kconfig
# kmod-trigger configuration
config TRIGGER_GIT_TREEISH
	string
	prompt "treeish of kmod-trigger git repository"
	default "kmod-trigger-v2.6.31-dni4"
	help
           Input the treeish of kmod-trigger git repository which you want to build

config TRIGGER_GIT_REPOSITORY
	string
	prompt "name of kmod-trigger git repository"
	default "kmod-trigger.git"
	help
	   Input the name of kmod-trigger git repository which you want to build

config TRIGGER_GIT_URL
	string
	prompt "url of kmod-trigger git repository"
	default "ssh://dniserver/scm/dnigit/common/kmods/kmod-trigger.git"
	help
	   Input the url of kmod-trigger git repository which you want to build
```

## package/kmod-urlblock/Config.in
```kconfig
# kmod-urlblock configuration
config URLBLOCK_GIT_TREEISH
	string
	prompt "treeish of urlblock git repository"
	default "kmod-urlblock-v2.6.31-dni5"
	help
           Input the treeish of kmod-urlblock git repository which you want to build

config URLBLOCK_GIT_REPOSITORY
	string
	prompt "name of urlblock git repository"
	default "kmod-urlblock.git"
	help
	   Input the name of kmod-urlblock git repository which you want to build

config URLBLOCK_GIT_URL
	string
	prompt "url of urlblock git repository"
	default "ssh://dniserver/scm/dnigit/common/kmods/kmod-urlblock.git"
	help
	   Input the url of kmod-urlblock git repository which you want to build
```

## package/lltd/Config.in
```kconfig
config LLTD_GIT_TREEISH
	string
	prompt "treeish of lltd git repository"
	default "lltd-v1.2-dni2"
	help
           Input the treeish of lltd git repository which you want to build

config LLTD_GIT_REPOSITORY
        string
        prompt "name of lltd git repository"
        default "lltd.git"
        help
           Input the name of lltd git repository which you want to build

config LLTD_GIT_URL
        string
        prompt "url of lltd git repository"
        default "ssh://dniserver/scm/dnigit/common/apps/lltd.git"
        help
           Input the url of lltd git repository which you want to build
```

## package/miniupnpd/Config.in
```kconfig
config MINIUPNPD_GIT_TREEISH
	string
	prompt "treeish of miniupnpd git repository"
	default "HEAD"
	help
	  input the treeish of miniupnpd git repository which you want to build

config MINIUPNPD_FRIENDLYNAME
	string
	prompt "Friendly name of the router"
	default "NETGEAR WNDR4500v3 Wireless Router"
	help
	  Friendly name of the router, such as NETGEAR WNDR4500v3 Wireless Router

config MINIUPNPD_MODELNAME
	string
	prompt "Model name of the route"
	default "RangeMax N300 Wireless Router"
	help
	  Model name of the router, such as RangeMax N300 Wireless Router

config MINIUPNPD_MODELNUMBER
	string
	prompt "Model number of the router"
	default "WNDR4500v3"
	help
	  Model number of the router, such as WNDR4500v3

config MINIUPNPD_DEVUPC
	string
	prompt "Universal Product Code of the router"
	default "030955554471"
	help
	  Model number of the router, such as 030955554471

config MINIUPNPD_MODELURL
	string
	prompt "Model url of the router"
	default "http://www.netgear.com/home/products/wirelessrouters"
	help
	  Model url of the router, such as http://www.netgear.com/home/products/wirelessrouters/simplesharing/WNR1000v4.aspx

config MINIUPNPD_SUPPORT_PNPX
	bool "Support Microsoft PnP-X function"
	default n
	help
	  Under Windows Vista and Windows 7, Plug and Play Extensions (PnP-X) allows network-connected
	  devices to be discovered and installed on a PC client as if they were connected physically.
	  URL: http://www.microsoft.com/whdc/connect/rally/rallypnpx.mspx

	  If unsure, say N.

config MINIUPNPD_PNPX_HWID
	depends on MINIUPNPD_SUPPORT_PNPX
	string
	prompt "PnP-X HW ID"
	default "VEN_01f2&DEV_000c&REV_01 VEN_01f2&DEV_8000&SUBSYS_01&REV_01 VEN_01f2&DEV_8000&REV_01 VEN_0033&DEV_0008&REV_01"
	help
	  For NETGEAR Router, the PnP-X HW ID have 3 parts: [NTGR Specific HW ID] [NTGR Generic HW ID] VEN_0033&DEV_0008&REV_01
	  thereinto, [NTGR Specific HW ID] is assigned by NTGR and each ID is used specifically for a specific model.
	  [NTGR Generic HW ID] For a router product without a USB port, use VEN_01f2&DEV_8000&REV_01; for a router product with
	  a USB port, use VEN_01f2&DEV_8000&SUBSYS_01&REV_01 VEN_01f2&DEV_8000&REV_01.
	  VEN_0033&DEV_0008&REV_01 is Microsoft Specific HW ID for IGD
```

## package/net-cgi/Config.in
```kconfig
config NET_CGI_GIT_TREEISH
	string
	prompt "treeish of net-cgi git repository"
	default "net-cgi-dni191"
	help
           Input the treeish of net-cgi git repository which you want to build

config NET_CGI_GIT_REPOSITORY
	string
	prompt "name of net-cgi git repository"
	default "net-cgi.git"
	help
	   Input the name of net-cgi git repository which you want to build

config NET_CGI_GIT_URL
	string
	prompt "url of net-cgi git repository"
	default "ssh://dniserver/scm/dnigit/common/apps/net-cgi.git"
	help
	   Input the url of net-cgi git repository which you want to build
```

## package/net-scan/Config.in
```kconfig
config NET_SCAN_GIT_TREEISH
	string
	prompt "treeish of net-scan git repository"
	default "net-scan-v1.0-dni25"
	help
           Input the treeish of net-scan git repository which you want to build

config NET_SCAN_GIT_REPOSITORY
        string
        prompt "name of net-scan git repository"
        default "net-scan.git"
        help
           Input the name of net-scan git repository which you want to build

config NET_SCAN_GIT_URL
        string
        prompt "url of net-scan git repository"
        default "ssh://dniserver/scm/dnigit/common/apps/net-scan.git"
        help
           Input the url of net-scan git repository which you want to build
```

## package/net-util/Config.in
```kconfig
config NET_UTIL_GIT_TREEISH
	string
	prompt "treeish of net-util git repository"
	default "net-util-dni37"
	help
           Input the treeish of net-util git repository which you want to build

config NET_UTIL_GIT_REPOSITORY
        string
        prompt "name of net-util git repository"
        default "net-util.git"
        help
           Input the name of net-util git repository which you want to build

config NET_UTIL_GIT_URL
        string
        prompt "url of net-util git repository"
        default "ssh://dniserver/scm/dnigit/common/apps/net-util.git"
        help
           Input the url of net-util git repository which you want to build
```

## package/net-wall/Config.in
```kconfig
config NET_WALL_GIT_TREEISH
	string
	prompt "treeish of net-wall git repository"
	default "net-wall-v2.0-dni95"
	help
           Input the treeish of net-wall git repository which you want to build

config NET_WALL_GIT_REPOSITORY
	string
	prompt "name of net-wall git repository"
	default "net-wall.git"
	help
	   Input the name of net-wall git repository which you want to build

config NET_WALL_GIT_URL
	string
	prompt "url of net-wall git repository"
	default "ssh://dniserver/scm/dnigit/common/apps/net-wall.git"
	help
	   Input the url of net-wall git repository which you want to build
```

## package/net6conf/Config.in
```kconfig
config NET6CONF_GIT_TREEISH
	string
	prompt "treeish of net6conf git repository"
	default "net6conf-dni91"
	help
           Input the treeish of net6conf git repository which you want to build

config NET6CONF_GIT_REPOSITORY
	string
	prompt "net6conf git repository"
	default "net6conf.git"
	help
	  Input the name of net6conf git repository which you want to build

config NET6CONF_GIT_URL
	string
	prompt "net6conf git url"
	default "ssh://dniserver/scm/dnigit/common/apps/net6conf.git"
	help
	  Input the url of net6conf git repository which you want to build
```

## package/noip/Config.in
```kconfig
config NOIP_GIT_TREEISH
	string
	prompt "treeish of noip git repository"
	default "noip-2.1.9-dni1"
	help
           Input the treeish of noip git repository which you want to build

config NOIP_GIT_REPOSITORY
	string
	prompt "name of noip git repository"
	default "noip.git"
	help
	   Input the name of noip git repository which you want to build

config NOIP_GIT_URL
	string
	prompt "url of noip git repository"
	default "ssh://dniserver/scm/dnigit/common/apps/noip.git"
	help
	   Input the url of noip git repository which you want to build
	   
config NOIP_USE_LOCAL_SRC
	bool
	prompt "use location source codes of noip module"
	default n
	help
	  Change to use Local Source Codes, Not from git repository.
```

## package/ntgrddns/Config.in
```kconfig
config DNI_NTGRDDNS_GIT_TREEISH
	string
	prompt "treeish of dni ntgrddns git repository"
	default "ntgrddns-dni7"
	help
           Input the treeish of dni ntgrddns git repository which you want to build

config DNI_NTGRDDNS_GIT_REPOSITORY
	string
	prompt "name of dni ntgrddns git repository"
	default "ntgrddns.git"
	help
	   Input the name of dni ntgrddns git repository which you want to build
```

## package/phddns/Config.in
```kconfig
config PHDDNS_GIT_TREEISH
	string
	prompt "treeish of phddns git repository"
	default "phddns-sdk-1.0.4-dni1"
	help
           Input the treeish of phddns git repository which you want to build

config PHDDNS_GIT_REPOSITORY
	string
	prompt "name of phddns git repository"
	default "phddns.git"
	help
	   Input the name of phddns git repository which you want to build

config PHDDNS_GIT_URL
	string
	prompt "url of phddns git repository"
	default "ssh://dniserver/scm/dnigit/common/apps/phddns.git"
	help
	   Input the url of phddns git repository which you want to build
```
