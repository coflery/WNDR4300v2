## package/telnetenable/Config.in
```kconfig
config TELNETENABLE_GIT_TREEISH
	string
	prompt "treeish of telnetenable git repository"
	default "HEAD"
	help
	  input the treeish of telnetenable git repository which you want to build
```

## package/trafficmeter/Config.in
```kconfig
config TRAFFICMETER_GIT_TREEISH
	string
	prompt "treeish of trafficmeter git repository"
	default "trafficmeter-v2.0.0-dni41"
	help
           Input the treeish of trafficmeter git repository which you want to build

config TRAFFICMETER_GIT_REPOSITORY
	string
	prompt "name of trafficmeter git repository"
	default "trafficmeter.git"
	help
	   Input the name of trafficmeter git repository which you want to build

config TRAFFICMETER_GIT_URL
	string
	prompt "url of trafficmeter git repository"
	default "ssh://dniserver/scm/dnigit/common/apps/trafficmeter.git"
	help
	   Input the url of trafficmeter git repository which you want to build
```

## package/wide-dhcpv6/Config.in
```kconfig
config WIDE_DHCPV6_CLIENT_GIT_TREEISH
	string
	prompt "treeish of wide-dhcpv6 client git repository"
	default "wide-dhcpv6-dni81"
	help
           Input the treeish of wide-dhcpv6 client git repository which you want to build

config WIDE_DHCPV6_CLIENT_GIT_REPOSITORY
	string
	prompt "name of wide-dhcpv6 client git repository"
	default "wide-dhcpv6.git"
	help
	   Input the name of wide-dhcpv6 client git repository which you want to build

config WIDE_DHCPV6_CLIENT_GIT_URL
	string
	prompt "url of wide-dhcpv6 client git repository"
	default "ssh://dniserver/scm/dnigit/common/apps/wide-dhcpv6.git"
	help
	   Input the url of wide-dhcpv6 client git repository which you want to build
```

## package/wireless-tools/Config.in
```kconfig
# wireless tools configuration

config WIRELESS_TOOLS_ANY_SSID_HACK
	bool "Enable any SSID hack"
	depends on PACKAGE_wireless-tools
	default n
        help
          This is to enable the hack of accepting string "any"
          as SSID.
```
